## boards/vend/esp32c3_can/Kconfig
```kconfig
# ESP32C3 supermini board configuration

config HEAP_MEM_POOL_ADD_SIZE_BOARD
	int
	default 4096
```

## boards/vend/esp32c3_can/board.yml
```yaml
# Copyright (c) 2024 Arrel Neumiller
# SPDX-License-Identifier: Apache-2.0

board:
  name: esp32c3_can
  full_name: ESP32-C3-CAN
  vendor: others
  socs:
  - name: esp32c3
```

## boards/vend/esp32c3_can/esp32c3_can_defconfig
```kconfig
# Copyright (c) 2024 Arrel Neumiller
# SPDX-License-Identifier: Apache-2.0

CONFIG_CONSOLE=y
CONFIG_SERIAL=y
CONFIG_UART_CONSOLE=y
CONFIG_GPIO=y

CONFIG_HAS_LED_RGB=y
# CONFIG_HAS_LED_SIMPLE=n

CONFIG_LED_STRIP=y
CONFIG_LED_STRIP_LOG_LEVEL_DBG=y
CONFIG_WS2812_STRIP_SPI=y

CONFIG_HEAP_MEM_POOL_SIZE=64536
CONFIG_HAS_CANBUS=y
```

## boards/vend/esp32s3_can/Kconfig
```kconfig
# Copyright (c) 2024 Espressif Systems (Shanghai) Co., Ltd.
# SPDX-License-Identifier: Apache-2.0

config HEAP_MEM_POOL_ADD_SIZE_BOARD
	int
	default 4096 if BOARD_ESP32S3_DEVKITC_ESP32S3_PROCPU
	default 256 if BOARD_ESP32S3_DEVKITC_ESP32S3_APPCPU

config BT_SCAN_UUID_CNT
	int
	default 1

config BT_SCAN_FILTER_ENABLE
	bool
	default y

config BT_SCAN_MANUFACTURER_DATA_CNT
	int
	default 0

config BT_SCAN_MANUFACTURER_DATA_MAX_LEN
	int
	default 32

config BT_SCAN_APPEARANCE_CNT
	int
	default 0

config BT_SCAN_ADDRESS_CNT
	int	
	default 1

config BT_SCAN_SHORT_NAME_CNT
	int
	default 0

config BT_SCAN_SHORT_NAME_MAX_LEN
	int
	default 32

config BT_SCAN_LOG_LEVEL
	int
	default 3 

config BT_GATT_DM_MAX_ATTRS
	int
	default 35

config BT_GATT_DM_LOG_LEVEL
	int
	default 3

config BT_SCAN_NAME_CNT
	int
	default 0

config BT_SCAN_NAME_MAX_LEN
	int
	default 32
```

## boards/vend/esp32s3_can/Kconfig.esp32s3_can
```kconfig
# Copyright (c) 2024 Espressif Systems (Shanghai) Co., Ltd.
# SPDX-License-Identifier: Apache-2.0

config BOARD_ESP32S3_CAN
	bool
	select SOC_ESP32S3_WROOM_N8
	select SOC_ESP32S3_PROCPU if BOARD_ESP32S3_DEVKITC_ESP32S3_PROCPU
	select SOC_ESP32S3_APPCPU if BOARD_ESP32S3_DEVKITC_ESP32S3_APPCPU
	default y

config USE_NRF_SDK
	bool
	default n

config HAS_LED_SIMPLE
	bool
	default n

config HAS_LED_RGB
	bool
	default y

config SAMPLE_LED_BRIGHTNESS
	int "LED brightness"
	default 16
	range 1 255
	help
	  Brightness level of each LED. Defaults to a low value to make
	  it easier to distinguish colors.
```

## boards/vend/esp32s3_can/board.yml
```yaml
board:
  name: esp32s3_can
  full_name: ESP32-S3-CAN
  vendor: espressif
  socs:
  - name: esp32s3
```

## boards/vend/esp32s3_can/esp32s3_can_procpu_defconfig
```kconfig
# SPDX-License-Identifier: Apache-2.0

CONFIG_CONSOLE=y
CONFIG_SERIAL=y
CONFIG_UART_CONSOLE=y
CONFIG_GPIO=y
CONFIG_CLOCK_CONTROL=y

CONFIG_GPIO=y
# CONFIG_SPI=y

CONFIG_LED_STRIP=y
CONFIG_LED_STRIP_LOG_LEVEL_DBG=y
CONFIG_WS2812_STRIP_SPI=y

CONFIG_HEAP_MEM_POOL_SIZE=64536
```

## boards/vend/goprocan_nrf52840/Kconfig
```kconfig
config USE_NRF_SDK
	bool
	default y

config HAS_CANBUS
	bool "CAN-BUS present onboard"
	default n

config HAS_LED_SIMPLE
	bool "Simple led"
	default n
```

## boards/vend/goprocan_nrf52840/Kconfig.goprocan_nrf52840
```kconfig
config BOARD_GOPROCAN_NRF52840
	select SOC_NRF52840_QFAA

# config USE_NRF_SDK
# 	bool
# 	default y

# config HAS_LED_SIMPLE
# 	bool
# 	default y

# config HAS_LED_RGB
# 	bool
# 	default n

# config SAMPLE_LED_BRIGHTNESS
# 	int "LED brightness"
# 	default 16
# 	range 1 255
# 	help
# 	  Brightness level of each LED. Defaults to a low value to make
# 	  it easier to distinguish colors.
```

## boards/vend/goprocan_nrf52840/goprocan_nrf52840_defconfig
```kconfig
CONFIG_ARM_MPU=y
CONFIG_HW_STACK_PROTECTION=y

CONFIG_BT_SCAN=y
CONFIG_BT_SCAN_FILTER_ENABLE=y
CONFIG_BT_SCAN_UUID_CNT=1
CONFIG_BT_SCAN_ADDRESS_CNT=1
CONFIG_BT_GATT_DM=y
CONFIG_BT_GATT_DM_DATA_PRINT=y

#CONFIG_CLOCK_CONTROL_NRF_K32SRC_RC=y
CONFIG_CLOCK_CONTROL_NRF_K32SRC_SYNTH=y
CONFIG_CLOCK_CONTROL_NRF_K32SRC_XTAL=n

CONFIG_GPIO=y
CONFIG_SPI=y
CONFIG_SPI_NRFX=y
#CONFIG_NRFX_SPIM1=y
#CONFIG_NRFX_SPIM0=y
CONFIG_NRFX_GPIOTE0=y

CONFIG_CAN_MCP2515=y

CONFIG_SPI_LOG_LEVEL_DBG=n
CONFIG_CAN_LOG_LEVEL_DBG=n


CONFIG_USE_SEGGER_RTT=y
CONFIG_LOG_BACKEND_RTT=y
CONFIG_LOG_BACKEND_UART=n

CONFIG_SEGGER_SYSTEMVIEW=y

CONFIG_SEGGER_RTT_BUFFER_SIZE_DOWN=8192
CONFIG_SEGGER_RTT_PRINTF_BUFFER_SIZE=8192

CONFIG_SHELL_BACKEND_RTT=y
#CONFIG_SHELL_BACKEND_RTT_BUFFER=1
CONFIG_LOG_BACKEND_RTT_BUFFER=1

CONFIG_HW_ID_LIBRARY=y

CONFIG_HEAP_MEM_POOL_SIZE=32768
# CONFIG_IDLE_STACK_SIZE=8192
# CONFIG_ISR_STACK_SIZE=8192
# CONFIG_MAIN_STACK_SIZE=4096
# CONFIG_BT_RX_STACK_SIZE=4096
# CONFIG_BT_HCI_TX_STACK_SIZE=1024
# CONFIG_SHELL_STACK_SIZE=4096
# CONFIG_ISR_SUBSTACK_SIZE=8192
#CONFIG_BT_DRV_RX_STACK_SIZE=1024

CONFIG_HAS_CANBUS=y
CONFIG_HAS_LED_SIMPLE=y
```

## boards/vend/rc_nrf5340/Kconfig.rc_nrf5340
```kconfig
config BOARD_RC_NRF5340
	select SOC_NRF5340_CPUAPP_QKAA if BOARD_RC_NRF5340_NRF5340_CPUAPP
	select SOC_NRF5340_CPUAPP_QKAA if BOARD_RC_NRF5340_NRF5340_CPUAPP_NS
	select SOC_NRF5340_CPUNET_QKAA if BOARD_RC_NRF5340_NRF5340_CPUNET

config USE_NRF_SDK
	bool
	default y

config BT_MAX_PAIRED
	int
	default 1
```

## boards/vend/rc_nrf5340/board.yml
```yaml
board:
  name: rc_nrf5340
  vendor: vend
  socs:
  - name: nrf5340
    variants:
    - name: ns
      cpucluster: cpuapp
```

## boards/vend/rc_nrf5340/rc_nrf5340_nrf5340_cpuapp_defconfig
```kconfig
CONFIG_ARM_MPU=y
CONFIG_HW_STACK_PROTECTION=y

CONFIG_ARM_TRUSTZONE_M=y

CONFIG_HAS_CANBUS=y

CONFIG_BT_SCAN=y
CONFIG_BT_SCAN_FILTER_ENABLE=y
CONFIG_BT_SCAN_UUID_CNT=1
CONFIG_BT_SCAN_ADDRESS_CNT=1
CONFIG_BT_GATT_DM=y
CONFIG_BT_GATT_DM_DATA_PRINT=y

CONFIG_USE_SEGGER_RTT=y
CONFIG_LOG_BACKEND_RTT=y
CONFIG_LOG_BACKEND_UART=n

CONFIG_SEGGER_SYSTEMVIEW=y

CONFIG_SEGGER_RTT_BUFFER_SIZE_DOWN=8192
CONFIG_SEGGER_RTT_PRINTF_BUFFER_SIZE=8192

CONFIG_SHELL_BACKEND_RTT=y
#CONFIG_SHELL_BACKEND_RTT_BUFFER=1
CONFIG_LOG_BACKEND_RTT_BUFFER=1

CONFIG_HW_ID_LIBRARY=y
```

## boards/vend/rc_nrf5340/rc_nrf5340_nrf5340_cpunet_defconfig
```kconfig
CONFIG_ARM_MPU=y
CONFIG_HW_STACK_PROTECTION=y

CONFIG_BT_SCAN=y
CONFIG_BT_SCAN_FILTER_ENABLE=y
CONFIG_BT_SCAN_UUID_CNT=1
CONFIG_BT_SCAN_ADDRESS_CNT=1
CONFIG_BT_GATT_DM=y
CONFIG_BT_GATT_DM_DATA_PRINT=y
```
